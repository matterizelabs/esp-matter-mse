## firmware/sdkconfig.defaults
```kconfig
# firmware/sdkconfig.defaults
CONFIG_ESPTOOLPY_FLASHSIZE_4MB=y
CONFIG_BT_ENABLED=y
CONFIG_BT_NIMBLE_ENABLED=y
CONFIG_BT_NIMBLE_ENABLE_CONN_REATTEMPT=n
CONFIG_LWIP_IPV6_AUTOCONFIG=y
CONFIG_PARTITION_TABLE_CUSTOM=y
CONFIG_PARTITION_TABLE_FILENAME="partitions.csv"
CONFIG_PARTITION_TABLE_OFFSET=0x8000
CONFIG_ENABLE_CHIP_SHELL=y
CONFIG_ENABLE_WIFI_AP=n
CONFIG_LWIP_HOOK_IP6_ROUTE_DEFAULT=y
CONFIG_LWIP_HOOK_ND6_GET_GW_DEFAULT=y
CONFIG_ESP_MATTER_MAX_DYNAMIC_ENDPOINT_COUNT=2
CONFIG_BUTTON_PERIOD_TIME_MS=20
CONFIG_BUTTON_LONG_PRESS_TIME_MS=5000
CONFIG_ESP_WIFI_SOFTAP_SUPPORT=n
CONFIG_ENABLE_OTA_REQUESTOR=n
CONFIG_MBEDTLS_HKDF_C=y

# Attestation: Certification Declaration + factory data (DAC/PAI/CD) providers
CONFIG_ENABLE_SET_CERT_DECLARATION_API=y
CONFIG_ENABLE_ESP32_FACTORY_DATA_PROVIDER=y
CONFIG_ENABLE_ESP32_DEVICE_INSTANCE_INFO_PROVIDER=y
CONFIG_FACTORY_COMMISSIONABLE_DATA_PROVIDER=y
CONFIG_FACTORY_DEVICE_INSTANCE_INFO_PROVIDER=y
CONFIG_FACTORY_PARTITION_DAC_PROVIDER=y
CONFIG_LWIP_IPV6_NUM_ADDRESSES=6
```

## main/Kconfig.projbuild
```kconfig
# firmware/main/Kconfig.projbuild
menu "WS2812 Matrix"
    config WS2812_GPIO
        int "WS2812 data GPIO"
        default 3
        range 0 39
    config MATRIX_WIDTH
        int "Matrix width"
        default 8
    config MATRIX_HEIGHT
        int "Matrix height"
        default 6
    config MATRIX_SERPENTINE
        bool "Serpentine (zigzag) wiring"
        default y
    config STREAM_FPS
        int "Stream FPS"
        default 30
endmenu
```
